## config/boards/shields/phantoma/Kconfig.defconfig
```kconfig
# Copyright (c) 2020 The ZMK Contributors
# SPDX-License-Identifier: MIT

if SHIELD_PHANTOMA_LEFT

config ZMK_KEYBOARD_NAME
	default "PHANTOMA_L"

config ZMK_SPLIT_BLE_ROLE_CENTRAL
	default y

endif

if SHIELD_PHANTOMA_RIGHT

config ZMK_KEYBOARD_NAME
	default "PHANTOMA_R"

endif

if SHIELD_PHANTOMA_RIGHT || SHIELD_PHANTOMA_LEFT

config ZMK_SPLIT
	default y

endif
```

## config/boards/shields/phantoma/Kconfig.shield
```kconfig
# Copyright (c) 2020 The ZMK Contributors
# SPDX-License-Identifier: MIT

config SHIELD_PHANTOMA_LEFT
	def_bool $(shields_list_contains,phantoma_left)

config SHIELD_PHANTOMA_RIGHT
	def_bool $(shields_list_contains,phantoma_right)
```
